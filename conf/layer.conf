## conf/layer.conf
```bitbake
# Layer configuration for meta-soc-xilinx
# Yocto Project Layer - Xilinx Zynq UltraScale+
# Compatible with Yocto scarthgap

BBPATH .= ":${LAYERDIR}"

BBFILES += "${LAYERDIR}/recipes-*/*/*.bb \
            ${LAYERDIR}/recipes-*/*/*.bbappend"

BBFILE_COLLECTIONS += "meta-soc-xilinx"
BBFILE_PATTERN_meta-soc-xilinx = "^${LAYERDIR}/"
BBFILE_PRIORITY_meta-soc-xilinx = "10"

LAYERDEPENDS_meta-soc-xilinx = "core"
LAYERDEPENDS_meta-soc-xilinx += "xilinx"
LAYERDEPENDS_meta-soc-xilinx += "openembedded-layer"
LAYERDEPENDS_meta-soc-xilinx += "meta-python"

LAYERSERIES_COMPAT_meta-soc-xilinx = "scarthgap kirkstone "

# Layer version
LAYERVERSION_meta-soc-xilinx = "1"
```
